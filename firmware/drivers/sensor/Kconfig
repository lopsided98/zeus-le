## firmware/drivers/sensor/Kconfig
```kconfig
# Copyright (c) 2024 Ben Wolsieffer
# SPDX-License-Identifier: Apache-2.0

rsource "ti/Kconfig"
```

## firmware/drivers/sensor/ti/Kconfig
```kconfig
# Copyright (c) 2024 Ben Wolsieffer
# SPDX-License-Identifier: Apache-2.0

rsource "bq2515x_adc/Kconfig"
```

## firmware/drivers/sensor/ti/bq2515x_adc/Kconfig
```kconfig
# Copyright (c) 2024 Ben Wolsieffer
#
# SPDX-License-Identifier: Apache-2.0

config BQ2515X_ADC
	bool "BQ2515x ADC"
	default y
	depends on DT_HAS_TI_BQ2515X_ADC_ENABLED
	select I2C
	select MFD
	help
	  Enable TI BQ2515x battery charger ADC driver.
```

## firmware/dts/bindings/richtek,rt6160.yaml
```yaml
# Copyright (c), 2024 Ben Wolsieffer
# SPDX-License-Identifier: Apache-2.0

description: |
  Richtek RT6160 Buck-Boost Converter

compatible: "richtek,rt6160"

include:
  - name: base.yaml
  - name: regulator.yaml
    property-allowlist:
      - regulator-always-on
      - regulator-boot-on
      - regulator-min-microvolt
      - regulator-max-microvolt
      - regulator-allowed-modes
      - regulator-initial-mode

properties:
  richtek,en-gpios:
    type: phandle-array
    description: GPIO connected to EN pin
  
  richtek,vsel-gpios:
    type: phandle-array
    description: GPIO connected to VSEL pin

  richtek,ramp-pwm:
    type: boolean
    description: |
      Enable ramp-PWM function, which runs the regulator in forced-PWM mode
      while slewing the output voltage.
```

## firmware/dts/bindings/ti,bq2515x-adc.yaml
```yaml
#
# Copyright (c) 2024 Ben Wolsieffer
#
# SPDX-License-Identifier: Apache-2.0
#

description: BQ2515x Battery Charger ADC

compatible: "ti,bq2515x-adc"

include: [sensor-device.yaml]

properties:
  read-rate:
    type: string
    default: "manual"
    description: |
      ADC read rate during battery operation. When VIN is connected the ADC
      always operates in continuous mode.
    enum: ["manual", "continuous", "1sec", "1min"]

  conversion-speed-ms:
    type: int
    default: 24
    description: |
      ADC conversion time in milliseconds. Longer times give higher accuracy.
    enum: [24, 12, 6, 3]
```

## firmware/dts/bindings/ti,bq2515x-charger.yaml
```yaml
# Copyright 2024 Ben Wolsieffer
# SPDX-License-Identifier: Apache-2.0

description: |
  BQ2515x battery charger device

compatible: "ti,bq2515x-charger"

include: [battery.yaml]

properties:
  constant-charge-current-max-microamp:
    type: int
    default: 0
    description: |
      Charge current set at init time in uA, available range is 1.25 mA to
      500 mA. The value specified will be rounded down to the next smallest
      implemented value. If set to 0 (default), skip setting the charge current
      value at driver initialization.

  input-current-max-milliamp:
    type: int
    default: 0
    enum: [0, 50, 100, 150, 200, 300, 400, 500, 600]
    description: |
      Input current limit set at init time in mA. If set to 0 (default), skip
      setting the input current limit at driver initialization.
```

## firmware/dts/bindings/ti,bq2515x-regulator.yaml
```yaml
# Copyright (c), 2024 Ben Wolsieffer
# SPDX-License-Identifier: Apache-2.0

description: |
  BQ2515x battery charger load-switch/LDO regulator

  The battery charger integrates a configurable load-switch or LDO. The LDO
  must be defined as a child node named "ldo", for example:

  bq25155@6b {
    reg = <0x6b>;
    ...
    regulators {
      compatible = "ti,bq2515x-regulator";

      ldo {
        /* properties for LDO */
      };
    };
  };

compatible: "ti,bq2515x-regulator"

include: base.yaml

child-binding:
  include:
    - name: regulator.yaml
      property-allowlist:
        - regulator-always-on
        - regulator-boot-on
        - regulator-min-microvolt
        - regulator-max-microvolt
        - regulator-allowed-modes
        - regulator-initial-mode
```

## firmware/dts/bindings/ti,bq2515x.yaml
```yaml
# Copyright 2024 Ben Wolsieffer
# SPDX-License-Identifier: Apache-2.0

description: |
  BQ25150/BQ25155/BQ25157 I2C Controlled, 500-mA, 1-cell linear charger with
  10-nA IQ, power path, regulated system voltage, 16-bit ADC and LDO

  The device has child nodes for the charger and LS/LDO. For example:

  bq25155@6b {
    compatible = "ti,bq2515x";
    reg = <0x6b>;
    lp-gpios = <&gpio1 15 GPIO_ACTIVE_LOW>;
    int-gpios = <&gpio1 0 GPIO_ACTIVE_LOW>;

    charger {
      compatible = "ti,bq2515x-charger";

      constant-charge-current-max-microamp = <200000>;
      input-current-max-milliamp = <500>;
    };

    regulators {
      compatible = "ti,bq2515x-regulator";

      ldo {
        regulator-initial-mode = <BQ2515X_REGULATOR_MODE_LDO>;
        regulator-min-microvolt = <3100000>;
        regulator-max-microvolt = <3500000>;
      };
    };
  };

compatible: "ti,bq2515x"

include: i2c-device.yaml

properties:
  lp-gpios:
    type: phandle-array

  int-gpios:
    type: phandle-array

  pg-mode:
    type: string
    default: "pg"
    enum: ["pg", "mr", "gpo"]
    description: |
      Configure PG pin as a VIN power-good output, level shifted MR output or
      general purpose open-drain output.
```

## firmware/dts/bindings/ti,lp58xx.yaml
```yaml
# Copyright (c) 2024 Ben Wolsieffer
# SPDX-License-Identifier: Apache-2.0

include: ["i2c-device.yaml", "led-controller.yaml"]

properties:
  max-current-microamps:
    type: int
    default: 25500
    description: |
      Maximum current limit across all LEDs. This also determines the current
      control resolution for each LED.
    enum: [25500, 51000]

  lsd-threshold-percent:
    type: int
    default: 35
    description: |
      LED short detection threshold as a percent of VCC
    enum: [35, 45, 55, 65]

child-binding:
  properties:
    label:
      required: true

    index:
      required: true

    color-mapping:
      required: true

    manual-current-microamps:
      type: array
      required: true
      description: |
        DC current setting for this LED in manual mode.

    auto-current-microamps:
      type: array
      required: true
      description: |
        DC current setting for this LED in autonomous mode.

    exponential-dimming:
      type: boolean
      description: |
        Enable expontial PWM dimming instead of linear dimming for this LED.

    phase-align:
      type: string-array
      required: true
      # enum:
      #   - "forward"
      #   - "middle"
      #   - "backward"
```

## firmware/dts/bindings/ti,tlv320adcx120.yaml
```yaml
# SPDX-License-Identifier: GPL-3.0-or-later

description: TI TLV320ADCx120 Audio ADC

compatible: ti,tlv320adcx120

include: i2c-device.yaml

properties:
  int-gpios:
    type: phandle-array

  avdd-supply:
    type: phandle
    description: |
      Reference to the regulator that controls power to the AVDD supply rail.
      The referenced devicetree node must have a regulator compatible.

  internal-areg:
    type: boolean
    description: |
      Use the internally generated 1.8V AREG supply.

child-binding:
  description: Input channel configuration

  properties:
    channel: 
      type: int
      description: Channel number (1-4)
      enum: [1, 2, 3, 4]
    line-in:
      type: boolean
      description: Enable line input mode.
    dc-coupled:
      type: boolean
      description: Enable DC coupled input mode.
    impedance-ohms:
      type: int
      default: 2500
      description: Channel input impedance in ohms.
      enum: [ 2500, 10000, 20000 ]
    slot:
      type: int
      required: true
      description: Channel slot assignment in ASI data
```

## firmware/lftpd/Kconfig
```kconfig
menuconfig LFTPD
	bool "lftpd FTP server"
    depends on FILE_SYSTEM
	help
	  Enable the lftpd FTP server

if LFTPD

module = LFTPD
module-str = lftpd
source "subsys/logging/Kconfig.template.log_config"

config LFTPD_MAX_PATH_LEN
	int "Maximum FTP command path length"
    default 128
	help
	  Maximum FTP command path length. The FTP server base directory is
	  included in this length.

endif # LFTPD
```

## firmware/west.yml
```yaml
manifest:
  group-filter:
    - +babblesim
  remotes:
    - name: babblesim
      url-base: https://github.com/BabbleSim
    - name: zephyrproject-rtos
      url-base: https://github.com/zephyrproject-rtos
    - name: lopsided98
      url-base: https://github.com/lopsided98
  projects:
    - name: zephyr
      remote: lopsided98
      revision: 6bf887504555a4e5860d6d426100d696760fe9f3
      import:
        name-allowlist:
          - babblesim_base
          - babblesim_ext_2G4_channel_NtNcable
          - babblesim_ext_2G4_libPhyComv1
          - babblesim_ext_2G4_modem_magic
          - babblesim_ext_2G4_phy_v1
          - bsim
          - cmsis
          - fatfs
          - hal_nordic
          - hostap
          - libmetal
          - mbedtls
          - net-tools
          - open-amp
          - picolibc
          - tinycrypt
    - name: babblesim_ext_nRF_hw_models
      remote: babblesim
      repo-path: ext_nRF_hw_models.git
      path: tools/bsim/components/ext_nRF_hw_models
      revision: 3ede17158a9fe85c160e0384c0ad0306e24ee47e
    - name: west-nix
      remote: lopsided98
      revision: 3f31c82804e217842dc40e21ab8f95a037dfc8f7
      import: true
      path: tools/west-nix
  self:
    path: firmware
```
