## CMakeLists.txt
```
# SPDX-License-Identifier: GPL-3.0-or-later
cmake_minimum_required(VERSION 3.20.0)

find_package(Zephyr REQUIRED HINTS $ENV{ZEPHYR_BASE})

if(("${BOARD}" STREQUAL "zeus_le") OR
    ("${BOARD}" STREQUAL "raytac_mdbt53_db_40") OR
    ("${BOARD}" STREQUAL "nrf5340bsim"))
    message(INFO " ${BOARD} used for Network Core")
else()
    message(FATAL_ERROR "${BOARD} is not supported")
endif()

project(zeus_le_audio_net LANGUAGES C)

add_subdirectory(../../hci_ipc hci_ipc)
add_subdirectory(../common audio_common)

target_sources(app PRIVATE src/main.c)
target_link_libraries(app PRIVATE
    hci_ipc
    zeus_audio_common
)
target_include_directories(app PRIVATE
    ${ZEPHYR_BASE}/subsys # Need private Bluetooth headers
)
```

## prj.conf
```kconfig
### IPC
CONFIG_IPC_SERVICE=y
CONFIG_MBOX=y
# Three IPC endpoints: HCI, sync and logging
CONFIG_IPC_SERVICE_BACKEND_RPMSG_NUM_ENDPOINTS_PER_INSTANCE=3

CONFIG_HEAP_MEM_POOL_SIZE=8192

CONFIG_MAIN_STACK_SIZE=512
CONFIG_SYSTEM_WORKQUEUE_STACK_SIZE=512

CONFIG_SERIAL=n

### Logging
CONFIG_LOG=y
# Send logs to app core
CONFIG_LOG_BACKEND_IPC_SERVICE=y
# Deferred mode required for IPC logging
CONFIG_LOG_MODE_DEFERRED=y
CONFIG_LOG_PROCESS_THREAD=y

### Bluetooth LE
CONFIG_BT=y
CONFIG_BT_PERIPHERAL=n
# Central, connects to other devices
CONFIG_BT_CENTRAL=y
# Raw HCI over IPC from application core
CONFIG_BT_HCI_RAW=y
CONFIG_BT_EXT_ADV=y
CONFIG_BT_PER_ADV_SYNC=y
# Workaround: Unable to allocate command buffer when using K_NO_WAIT since
# Host number of completed commands does not follow normal flow control.
CONFIG_BT_BUF_CMD_TX_COUNT=10

# Enable and adjust the below value as necessary
# CONFIG_BT_BUF_EVT_RX_COUNT=16
# CONFIG_BT_BUF_EVT_RX_SIZE=255
# CONFIG_BT_BUF_ACL_RX_SIZE=255
# CONFIG_BT_BUF_ACL_TX_SIZE=251
# CONFIG_BT_BUF_CMD_TX_SIZE=255

CONFIG_NRFX_TIMER2=y
```

## boards/nrf5340bsim_nrf5340_cpunet.conf
```kconfig
# Use IPC log backend instead
CONFIG_LOG_BACKEND_NATIVE_POSIX=n
# Have lots of memory, increase log buffer to prevent dropped messages
CONFIG_LOG_BUFFER_SIZE=8192
```

## boards/raytac_mdbt53_db_40_nrf5340_cpunet.conf
```kconfig
CONFIG_LOG_BACKEND_IPC_SERVICE=y
CONFIG_LOG_SIMPLE_MSG_OPTIMIZE=n # Breaks IPC logging
```

## app.overlay
```dts
// SPDX-License-Identifier: GPL-3.0-or-later

#include "../common/audio.dtsi"

// Required to enable BT_LLL_VENDOR_NORDIC
&timer0 {
	status = "disabled";
};

// Disable unused hardware
&uart0 {
	status = "disabled";
};
```

## src/main.c
```c
// SPDX-License-Identifier: GPL-3.0-or-later
#include <hal/nrf_clock.h>
#include <hal/nrf_ipc.h>
#include <zephyr/kernel.h>
#include <zephyr/logging/log.h>

#include "hci_ipc.h"
#include "zeus/sync.h"

LOG_MODULE_REGISTER(audio_net);

static int packet_timer_init(void) {
    // Subscribe to radio end event through existing DPPI channel configured by
    // BLE driver
    nrf_ipc_subscribe_set(NRF_IPC,
                          nrf_ipc_send_task_get(ZEUS_PACKET_END_MBOX_CHANNEL),
                          HAL_RADIO_END_TIME_CAPTURE_PPI);

    return 0;
}

int main(void) {
    int err;

    err = packet_timer_init();
    if (err) {
        return err;
    }

    err = hci_ipc_init();
    if (err) {
        return err;
    }

    LOG_INF("Booted");

    return 0;
}
```
