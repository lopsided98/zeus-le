## firmware/Kconfig
```kconfig
# Copyright (c) 2024 Ben Wolsieffer
# SPDX-License-Identifier: GPL-3.0-or-later

rsource "drivers/Kconfig"
```

## firmware/audio/app/src/drivers/Kconfig
```kconfig
rsource "disk/Kconfig"

config AUDIO_DUMMY_CODEC
	bool "No-op input codec"
	depends on DT_HAS_ZEPHYR_DUMMY_CODEC_ENABLED
	help
	  Enable dummy input codec implementation

config I2S_ALSA
	bool "Simulated I2S using ALSA"
	depends on DT_HAS_LINUX_ALSA_I2S_ENABLED
	depends on ARCH_POSIX
	help
	  Enable simulated I2S support using ALSA

config I2S_TONE
	bool "Simulated I2S with constant frequency tone"
	depends on DT_HAS_ZEPHYR_TONE_I2S_ENABLED
	help
	  Enable simulated I2S driver that outputs a constant frequency tone

config AUDIO_SGTL5000
	bool "SGTL5000 codec support"
	default y
	depends on DT_HAS_NXP_SGTL5000_ENABLED
	select I2C
	help
	  Enable SGTL5000 codec support on the selected board

config AUDIO_TLV320ADCX120
	bool "TLV320ADCx120 ADC support"
	default y
	depends on DT_HAS_TI_TLV320ADCX120_ENABLED
	select I2C
	depends on GPIO
	help
	  Enable TLV320ADCx120 support on the selected board
```

## firmware/audio/app/src/drivers/disk/Kconfig
```kconfig
# Copyright (c) 2021 Nordic Semiconductor ASA
# Copyright (c) 2024 Ben Wolsieffer
# SPDX-License-Identifier: Apache-2.0

menuconfig DISK_DRIVERS
	bool "Disk drivers"
	help
	  Disk Driver configuration

if DISK_DRIVERS

rsource "Kconfig.cache"

endif # DISK_DRIVERS
```

## firmware/audio/app/src/drivers/disk/Kconfig.cache
```kconfig
# Copyright (c) 2016 Intel Corporation
# Copyright (c) 2024 Ben Wolsieffer
# SPDX-License-Identifier: Apache-2.0

config DISK_DRIVER_CACHE
	bool "Disk driver caching layer"
	depends on DT_HAS_ZEPHYR_DISK_CACHE_ENABLED
	default y
	help
	  Cache layer on top of another disk driver.

if DISK_DRIVER_CACHE

module = DISK_CACHE
module-str = "Disk cache"
source "subsys/logging/Kconfig.template.log_config"

endif # DISK_DRIVER_CACHE
```

## firmware/common/Kconfig
```kconfig
# SPDX-License-Identifier: GPL-3.0-or-later

choice ZEUS_NODE
    prompt "Zeus node type for common code"

config ZEUS_NODE_AUDIO
	bool "Zeus audio node"

config ZEUS_NODE_CENTRAL
	bool "Zeus central node"

endchoice
```

## firmware/common/boards/custom/zeus_le/Kconfig
```kconfig
# zeus-le nRF5340 board configuration

# Copyright (c) 2019 - 2021 Nordic Semiconductor ASA
# Copyright (c) 2024 Ben Wolsieffer
# SPDX-License-Identifier: Apache-2.0

if BOARD_ZEUS_LE_NRF5340_CPUAPP || BOARD_ZEUS_LE_NRF5340_CPUAPP_NS

config DOMAIN_CPUNET_BOARD
	string
	default "zeus_le/nrf5340/cpunet"
	help
	  The board which will be used for CPUNET domain when creating a multi
	  image application where one or more images should be located on
	  another board. For example hci_ipc on the nRF5340_cpunet for
	  Bluetooth applications.

endif # BOARD_ZEUS_LE_NRF5340_CPUAPP || BOARD_ZEUS_LE_NRF5340_CPUAPP_NS

if BOARD_ZEUS_LE_NRF5340_CPUNET

config DOMAIN_CPUAPP_BOARD
	string
	default "zeus_le/nrf5340/cpuapp"
	help
	  The board which will be used for CPUAPP domain when creating a multi
	  image application where one or more images should be located on
	  another board.

endif # BOARD_ZEUS_LE_NRF5340_CPUNET
```

## firmware/common/boards/custom/zeus_le/Kconfig.zeus_le
```kconfig
# zeus-le NRF5340 board configuration

# Copyright (c) 2019-2020 Nordic Semiconductor ASA
# Copyright (c) 2024 Ben Wolsieffer
# SPDX-License-Identifier: Apache-2.0

config BOARD_ZEUS_LE
	select SOC_NRF5340_CPUAPP_QKAA if BOARD_ZEUS_LE_NRF5340_CPUAPP
	select SOC_NRF5340_CPUAPP_QKAA if BOARD_ZEUS_LE_NRF5340_CPUAPP_NS
	select SOC_NRF5340_CPUNET_QKAA if BOARD_ZEUS_LE_NRF5340_CPUNET
```

## firmware/common/boards/custom/zeus_le/board.yml
```yaml
board:
  name: zeus_le
  vendor: custom
  socs:
  - name: 'nrf5340'
    variants:
    - name: 'ns'
      cpucluster: 'cpuapp'
```

## firmware/common/boards/custom/zeus_le/zeus_le_nrf5340_cpuapp_defconfig
```kconfig
# SPDX-License-Identifier: Apache-2.0

# Enable MPU
CONFIG_ARM_MPU=y

# Enable hardware stack protection
CONFIG_HW_STACK_PROTECTION=y

# Enable TrustZone-M
CONFIG_ARM_TRUSTZONE_M=y

# Enable GPIO
CONFIG_GPIO=y

# Enable UART driver
CONFIG_SERIAL=y

# Enable console
CONFIG_CONSOLE=y
CONFIG_UART_CONSOLE=y

# These should go in an app specific overlay
# CONFIG_AUDIO_SGTL5000=y
# CONFIG_I2C=y
CONFIG_MAIN_STACK_SIZE=2048
CONFIG_NET_TC_TX_COUNT=1
CONFIG_NRFX_EGU0=y
CONFIG_SDHC=y
CONFIG_SHELL_BACKEND_SERIAL_API_ASYNC=y
CONFIG_SOC_HFXO_CAP_INT_VALUE_X2=25
CONFIG_SOC_HFXO_CAP_INTERNAL=y
CONFIG_SPI_NRFX_RAM_BUFFER_SIZE=64
CONFIG_UART_ASYNC_API=y
CONFIG_UDC_DRIVER_LOG_LEVEL_WRN=y
CONFIG_USB_DEVICE_STACK_NEXT=y
CONFIG_USBD_CDC_ECM_CLASS=y
CONFIG_USBD_LOG_LEVEL_WRN=y
```

## firmware/common/dts/bindings/linux,alsa-i2s.yaml
```yaml
# SPDX-License-Identifier: GPL-3.0-or-later

description: Simulated I2S using ALSA

compatible: "linux,alsa-i2s"
```

## firmware/common/dts/bindings/ti,bq2515x-regulator.yaml
```yaml
# Copyright (c), 2024 Ben Wolsieffer
# SPDX-License-Identifier: Apache-2.0

description: |
  BQ2515x battery charger load-switch/LDO regulator

compatible: "ti,bq2515x-regulator"

include:
  - name: base.yaml
  - name: regulator.yaml
    property-allowlist:
      - regulator-always-on
      - regulator-boot-on
      - regulator-min-microvolt
      - regulator-max-microvolt
      - regulator-allowed-modes
      - regulator-initial-mode
```

## firmware/common/dts/bindings/ti,bq2515x.yaml
```yaml
# Copyright 2024 Ben Wolsieffer
# SPDX-License-Identifier: Apache-2.0

description: |
  BQ25150/BQ25155/BQ25157 I2C Controlled, 500-mA, 1-cell linear charger with
  10-nA IQ, power path, regulated system voltage, 16-bit ADC and LDO

  The device has child nodes for the charger and LS/LDO. For example:

  bq25155@6b {
    compatible = "ti,bq2515x";
    reg = <0x6b>;

    charger {
      compatible = "ti,bq2515x-charger";

      constant-charge-current-max-microamp = <200000>;
      input-current-max-milliamp = <500>;
    };

    ldo {
      compatible = "ti,bq2515x-regulator";
    };
  };

compatible: "ti,bq2515x"

include: i2c-device.yaml

properties:
  int-gpios:
      type: phandle-array
```

## firmware/common/dts/bindings/ti,lp5810.yaml
```yaml
description: Texas Instruments LP5810 I2C LED controller node

compatible: ti,lp5810

include: ti,lp58xx.yaml
```

## firmware/common/dts/bindings/zephyr,disk-cache.yaml
```yaml
# Copyright (c) 2024 Ben Wolsieffer
# SPDX-License-Identifier: Apache-2.0

description: Disk driver caching layer

compatible: "zephyr,disk-cache"

include: ["base.yaml"]

properties:
  disk-name:
    type: string
    required: true
    description: |
      Disk name.

  backing-disk-name:
    type: string
    required: true
    description: |
      Name of the disk that underlies the cache.

  sector-size:
    type: int
    required: true
    enum: [512, 1024, 2048, 4096, 8192, 16384, 32768, 65536]
    description: |
      Disk sector size in bytes. Must match the underlying disk.

  sector-count:
    type: int
    required: true
    description: |
      Number of sectors in the cache.
```

## firmware/common/dts/bindings/zephyr,tone-i2s.yaml
```yaml
# SPDX-License-Identifier: GPL-3.0-or-later

description: Simulated I2S with constant frequency sine tone

compatible: "zephyr,tone-i2s"

properties:
  frequency:
    type: int
    default: 440
    description: Tone frequency in Hz
```

## firmware/drivers/Kconfig
```kconfig
# Copyright (c) 2024 Ben Wolsieffer
# SPDX-License-Identifier: Apache-2.0

rsource "charger/Kconfig"
rsource "led/Kconfig"
rsource "mfd/Kconfig"
rsource "regulator/Kconfig"
rsource "sensor/Kconfig"
```

## firmware/drivers/charger/Kconfig
```kconfig
# Copyright 2024 Ben Wolsieffer
# SPDX-License-Identifier: Apache-2.0

menuconfig CHARGER
	bool "Battery charger drivers"
	help
	  Enable battery charger driver configuration.

if CHARGER

rsource "Kconfig.bq2515x"

endif # CHARGER
```

## firmware/drivers/charger/Kconfig.bq2515x
```kconfig
# Copyright 2024 Google LLC
# Copyright 2024 Ben Wolsieffer
#
# SPDX-License-Identifier: Apache-2.0

config CHARGER_BQ2515X
	bool "BQ2515x Battery Charger"
	default y
	depends on DT_HAS_TI_BQ2515X_CHARGER_ENABLED
	select I2C
	select MFD
	help
	  Enable BQ25150/BQ25155/BQ25157 battery charger driver.
```

## firmware/drivers/led/Kconfig
```kconfig
# Copyright 2024 Ben Wolsieffer
# SPDX-License-Identifier: Apache-2.0

menuconfig LED
	bool "Light-Emitting Diode (LED) drivers"
	help
	  Include LED drivers in the system configuration.

if LED

rsource "Kconfig.lp58xx"

endif # LED
```

## firmware/drivers/led/Kconfig.lp58xx
```kconfig
# Copyright (c) 2024 Ben Wolsieffer
# SPDX-License-Identifier: Apache-2.0

config LP58XX
	bool "LP58xx LED controller"
	default y
	depends on DT_HAS_TI_LP5810_ENABLED || DT_HAS_TI_LP5811_ENABLED || \
		   DT_HAS_TI_LP5812_ENABLED || DT_HAS_TI_LP5813_ENABLED
	select I2C
	help
	  Enable driver for the Texas Instruments LP58xx I2C LED
	  controllers. It supports: LP5810, LP5811, LP5812 and LP5813.
```

## firmware/drivers/mfd/Kconfig
```kconfig
# Copyright 2023 Nordic Semiconductor ASA
# Copyright 2024 Ben Wolsieffer
# SPDX-License-Identifier: Apache-2.0

menuconfig MFD
	bool "Multi-function device (MFD) drivers"
	help
	  Include drivers for multi-function devices

if MFD

rsource "Kconfig.bq2515x"

endif # MFD
```

## firmware/drivers/mfd/Kconfig.bq2515x
```kconfig
# Copyright (c) 2024 Ben Wolsieffer
# SPDX-License-Identifier: Apache-2.0

config MFD_BQ2515X
	bool "BQ2515x battery charger multi-function device driver"
	default y
	depends on DT_HAS_TI_BQ2515X_ENABLED
	select I2C
	help
	  Enable the TI BQ25150/BQ25155/BQ25157 battery charger multi-function
	  device driver.

config MFD_BQ2515X_INIT_PRIORITY
	int "BQ2515x MFD initialization priority"
	default MFD_INIT_PRIORITY
	depends on MFD_BQ2515X
	help
	  Multi-function device initialization priority for BQ2515x.
```

## firmware/drivers/regulator/Kconfig
```kconfig
# Copyright 2020 Peter Bigot Consulting, LLC
# Copyright 2024 Ben Wolsieffer
# SPDX-License-Identifier: Apache-2.0

menuconfig REGULATOR
	bool "Regulator drivers"
	help
	  Include drivers for current/voltage regulators in system config

if REGULATOR

rsource "Kconfig.bq2515x"
rsource "Kconfig.rt6160"

endif # REGULATOR
```

## firmware/drivers/regulator/Kconfig.bq2515x
```kconfig
# Copyright (c) 2024 Ben Wolsieffer
# SPDX-License-Identifier: Apache-2.0

config REGULATOR_BQ2515X
	bool "BQ2515x battery charger LS/LDO driver"
	default y
	depends on DT_HAS_TI_BQ2515X_REGULATOR_ENABLED
	select I2C
	select MFD
	help
	  Enable the TI BQ25150/BQ25155/BQ25157 battery charger
	  load-switch/LDO driver.

config REGULATOR_BQ2515X_INIT_PRIORITY
	int "BQ2515x regulator driver init priority"
	default 86
	depends on REGULATOR_BQ2515X
	help
	  Init priority for the BQ2515x regulator driver.
```

## firmware/drivers/regulator/Kconfig.rt6160
```kconfig
# Copyright (c) 2024 Ben Wolsieffer
# SPDX-License-Identifier: Apache-2.0

config REGULATOR_RT6160
	bool "RT6160 Buck-Boost Converter driver"
	default y
	depends on DT_HAS_RICHTEK_RT6160_ENABLED
	select I2C
	help
	  Enable the Richtek RT6160 buck-boost converter regulator
	  driver.

config REGULATOR_RT6160_INIT_PRIORITY
	int "RT6160 regulator driver init priority"
	default KERNEL_INIT_PRIORITY_DEVICE
	depends on REGULATOR_RT6160
	help
	  Init priority for the RT6160 regulator driver. It must
	  be greater than the I2C init priority.
```
