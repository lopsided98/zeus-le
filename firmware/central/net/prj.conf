## CMakeLists.txt
```
# SPDX-License-Identifier: GPL-3.0-or-later
cmake_minimum_required(VERSION 3.20.0)

find_package(Zephyr REQUIRED HINTS $ENV{ZEPHYR_BASE})

if(("${BOARD}" STREQUAL "zeus_le") OR
    ("${BOARD}" STREQUAL "raytac_mdbt53_db_40") OR
    ("${BOARD}" STREQUAL "nrf5340bsim"))
	message(INFO " ${BOARD} used for Network Core")
else()
	message(FATAL_ERROR "${BOARD} is not supported")
endif()

project(zeus_le_central_net LANGUAGES C)

add_subdirectory(../../hci_ipc hci_ipc)
add_subdirectory(../../protocol protocol)
add_subdirectory(../common central_common)

target_sources(app PRIVATE src/main.c)
target_link_libraries(app PRIVATE
    hci_ipc
    zeus_protocol
    zeus_central_common
)
target_include_directories(app PRIVATE
    ${ZEPHYR_BASE}/subsys # Need private Bluetooth headers
)
```

## prj.conf
```kconfig
### IPC
CONFIG_IPC_SERVICE=y
CONFIG_MBOX=y
# Three IPC endpoints: HCI, sync and logging
CONFIG_IPC_SERVICE_BACKEND_RPMSG_NUM_ENDPOINTS_PER_INSTANCE=3

CONFIG_HEAP_MEM_POOL_SIZE=8192

CONFIG_MAIN_STACK_SIZE=512
CONFIG_SYSTEM_WORKQUEUE_STACK_SIZE=512

CONFIG_SERIAL=n

### Logging
CONFIG_LOG=y
# Send logs to app core
CONFIG_LOG_BACKEND_IPC_SERVICE=y
# Deferred mode required for IPC logging
CONFIG_LOG_MODE_DEFERRED=y
CONFIG_LOG_PROCESS_THREAD=y

### Bluetooth LE
CONFIG_BT=y
# Raw HCI over IPC from application core
CONFIG_BT_HCI_RAW=y
CONFIG_BT_EXT_ADV=y
CONFIG_BT_PER_ADV=y
CONFIG_BT_EXT_ADV_MAX_ADV_SET=2
# Workaround: Unable to allocate command buffer when using K_NO_WAIT since
# Host number of completed commands does not follow normal flow control.
CONFIG_BT_BUF_CMD_TX_COUNT=10

# Enable and adjust the below value as necessary
# CONFIG_BT_BUF_EVT_RX_COUNT=16
# CONFIG_BT_BUF_EVT_RX_SIZE=255
# CONFIG_BT_BUF_ACL_RX_SIZE=255
# CONFIG_BT_BUF_ACL_TX_SIZE=251
# CONFIG_BT_BUF_CMD_TX_SIZE=255

CONFIG_NRFX_EGU0=y
CONFIG_NRFX_TIMER2=y
```

## boards/raytac_mdbt53_db_40_nrf5340_cpunet.conf
```kconfig
CONFIG_LOG_BACKEND_IPC_SERVICE=y
CONFIG_LOG_PROCESS_TRIGGER_THRESHOLD=1
```

## app.overlay
```dts
// SPDX-License-Identifier: GPL-3.0-or-later

#include "../common/central.dtsi"

// Required to enable BT_LLL_VENDOR_NORDIC
&timer0 {
	status = "disabled";
};

// Disable unused hardware
&uart0 {
	status = "disabled";
};
```

## dts/arm/nordic/override.dtsi
```dts
/* Keep default IRQ priority low for peripherals to reduce Radio ISR latency */
#define NRF_DEFAULT_IRQ_PRIORITY 5
```

## src/main.c
```c
// SPDX-License-Identifier: GPL-3.0-or-later
#include <nrfx_egu.h>
#include <nrfx_timer.h>
#include <zephyr/drivers/clock_control/nrf_clock_control.h>
#include <zephyr/ipc/ipc_service.h>
#include <zephyr/kernel.h>
#include <zephyr/logging/log.h>

#include "hci_ipc.h"
#include "zeus/protocol.h"
#include "zeus/sync.h"

// Zephyr internal headers, order is important
// clang-format off
#include <bluetooth/controller/ll_sw/pdu_df.h>
#include <bluetooth/controller/ll_sw/nordic/lll/pdu_vendor.h>
#include <bluetooth/controller/ll_sw/pdu.h>
// clang-format on

LOG_MODULE_REGISTER(central_net);

#define PACKET_TIMER_EGU_IDX 0
#define PACKET_TIMER_IDX 2

struct packet_timer {
    uint8_t seq;
    nrfx_timer_t timer;
    struct ipc_ept ept;
    struct onoff_client hf_cli;
} packet_timer;

static const struct ipc_ept_cfg packet_timer_ept_cfg = {
    .name = "packet_timer",
};

static void packet_timer_isr(uint8_t event_idx, void* context) {
    struct packet_timer* t = (struct packet_timer*)context;

    const struct pdu_adv* pdu = (const struct pdu_adv*)NRF_RADIO->PACKETPTR;
    if (!pdu) {
        LOG_WRN("Null PDU");
        return;
    }
    // Check PDU type, but this is not enough because all extended advertising
    // packets share the same type
    if (pdu->type != PDU_ADV_TYPE_AUX_SYNC_IND) return;
    // Make sure there is no extended advertising header. All extended
    // advertising packets except the periodic packet have a header.
    if (pdu->adv_ext_ind.ext_hdr_len != 0) return;

    const struct zeus_sync_msg msg = {
        .seq = t->seq++,
        .time = nrfx_timer_capture_get(&t->timer, NRF_TIMER_CC_CHANNEL0),
    };

    ipc_service_send(&t->ept, &msg, sizeof(msg));
}

static int packet_timer_init(void) {
    int err;
    nrfx_err_t nerr;
    const struct device* ipc = DEVICE_DT_GET(DT_NODELABEL(ipc0));

    err = ipc_service_open_instance(ipc);
    if (err < 0 && err != -EALREADY) {
        LOG_ERR("failed to initialize IPC (err %d)\n", err);
        return err;
    }
    err = ipc_service_register_endpoint(ipc, &packet_timer.ept,
                                        &packet_timer_ept_cfg);
    if (err < 0) {
        LOG_ERR("failed to register IPC endpoint (err %d)\n", err);
        return err;
    }

    packet_timer.timer = (nrfx_timer_t)NRFX_TIMER_INSTANCE(PACKET_TIMER_IDX);

    // Setup 32-bit 16 MHz timer to capture on radio end event
    nerr = nrfx_timer_init(&packet_timer.timer,
                           &(nrfx_timer_config_t){
                               .frequency = ZEUS_TIME_NOMINAL_FREQ,
                               .mode = NRF_TIMER_MODE_TIMER,
                               .bit_width = NRF_TIMER_BIT_WIDTH_32,
                           },
                           NULL);
    NRFX_ASSERT(NRFX_SUCCESS == nerr);

    // Subscribe to radio end event through existing DPPI channel configured by
    // BLE driver
    nrf_timer_subscribe_set(packet_timer.timer.p_reg, NRF_TIMER_TASK_CAPTURE0,
                            HAL_SW_SWITCH_TIMER_CLEAR_PPI);

    nrfx_egu_t egu = NRFX_EGU_INSTANCE(PACKET_TIMER_EGU_IDX);

    nrfx_egu_init(&egu, NRFX_EGU_DEFAULT_CONFIG_IRQ_PRIORITY, packet_timer_isr,
                  &packet_timer);
    IRQ_CONNECT(NRFX_IRQ_NUMBER_GET(NRF_EGU_INST_GET(PACKET_TIMER_EGU_IDX)), 5,
                NRFX_EGU_INST_HANDLER_GET(PACKET_TIMER_EGU_IDX), 0, 0);

    // Use EGU to fire interrupt when packet is transmitted
    nrf_egu_subscribe_set(egu.p_reg, NRF_EGU_TASK_TRIGGER0,
                          HAL_SW_SWITCH_TIMER_CLEAR_PPI);
    nrfx_egu_int_enable(&egu, NRF_EGU_INT_TRIGGERED0);

    // Keep HFCLK enabled and using HFXO all the time. This is required because
    // we need an accurate clock to run the timer.
    struct onoff_manager* mgr =
        z_nrf_clock_control_get_onoff(CLOCK_CONTROL_NRF_SUBSYS_HF);
    sys_notify_init_spinwait(&packet_timer.hf_cli.notify);
    onoff_request(mgr, &packet_timer.hf_cli);

    // Start the timer
    nrfx_timer_enable(&packet_timer.timer);

    return 0;
}

int main(void) {
    int err;

    err = packet_timer_init();
    if (err) {
        return err;
    }

    err = hci_ipc_init();
    if (err) {
        return err;
    }

    LOG_INF("Booted");

    return 0;
}
```

## src/hci_ipc.c
```c
/*
 * Copyright (c) 2019-2021 Nordic Semiconductor ASA
 *
 * SPDX-License-Identifier: Apache-2.0
 */

#include <errno.h>
#include <stddef.h>
#include <stdio.h>
#include <string.h>
#include <zephyr/bluetooth/bluetooth.h>
#include <zephyr/bluetooth/buf.h>
#include <zephyr/bluetooth/hci.h>
#include <zephyr/bluetooth/hci_raw.h>
#include <zephyr/bluetooth/hci_vs.h>
#include <zephyr/bluetooth/l2cap.h>
#include <zephyr/device.h>
#include <zephyr/ipc/ipc_service.h>
#include <zephyr/kernel.h>
#include <zephyr/logging/log.h>
#include <zephyr/logging/log_ctrl.h>
#include <zephyr/net/buf.h>
#include <zephyr/sys/byteorder.h>
#include <zephyr/sys/util.h>

LOG_MODULE_REGISTER(hci_ipc, CONFIG_BT_LOG_LEVEL);

static struct ipc_ept hci_ept;

static K_THREAD_STACK_DEFINE(rx_thread_stack, 512);
static struct k_thread rx_thread_data;
static K_FIFO_DEFINE(rx_queue);

static K_THREAD_STACK_DEFINE(tx_thread_stack, CONFIG_BT_HCI_TX_STACK_SIZE);
static struct k_thread tx_thread_data;
static K_FIFO_DEFINE(tx_queue);

static K_SEM_DEFINE(ipc_bound_sem, 0, 1);
#if defined(CONFIG_BT_CTLR_ASSERT_HANDLER) || \
    defined(CONFIG_BT_HCI_VS_FATAL_ERROR)
/* A flag used to store information if the IPC endpoint has already been bound.
 * The end point can't be used before that happens.
 */
static bool ipc_ept_ready;
#endif /* CONFIG_BT_CTLR_ASSERT_HANDLER || CONFIG_BT_HCI_VS_FATAL_ERROR */

#define HCI_IPC_CMD 0x01
#define HCI_IPC_ACL 0x02
#define HCI_IPC_SCO 0x03
#define HCI_IPC_EVT 0x04
#define HCI_IPC_ISO 0x05

#define HCI_FATAL_ERR_MSG true
#define HCI_REGULAR_MSG false

static struct net_buf *hci_ipc_cmd_recv(uint8_t *data, size_t remaining) {
    struct bt_hci_cmd_hdr *hdr = (void *)data;
    struct net_buf *buf;

    if (remaining < sizeof(*hdr)) {
        LOG_ERR("Not enough data for command header");
        return NULL;
    }

    buf = bt_buf_get_tx(BT_BUF_CMD, K_NO_WAIT, hdr, sizeof(*hdr));
    if (buf) {
        data += sizeof(*hdr);
        remaining -= sizeof(*hdr);
    } else {
        LOG_ERR("No available command buffers!");
        return NULL;
    }

    if (remaining != hdr->param_len) {
        LOG_ERR("Command payload length is not correct");
        net_buf_unref(buf);
        return NULL;
    }

    if (remaining > net_buf_tailroom(buf)) {
        LOG_ERR("Not enough space in buffer");
        net_buf_unref(buf);
        return NULL;
    }

    LOG_DBG("len %u", hdr->param_len);
    net_buf_add_mem(buf, data, remaining);

    return buf;
}

static struct net_buf *hci_ipc_acl_recv(uint8_t *data, size_t remaining) {
    struct bt_hci_acl_hdr *hdr = (void *)data;
    struct net_buf *buf;

    if (remaining < sizeof(*hdr)) {
        LOG_ERR("Not enough data for ACL header");
        return NULL;
    }

    buf = bt_buf_get_tx(BT_BUF_ACL_OUT, K_NO_WAIT, hdr, sizeof(*hdr));
    if (buf) {
        data += sizeof(*hdr);
        remaining -= sizeof(*hdr);
    } else {
        LOG_ERR("No available ACL buffers!");
        return NULL;
    }

    if (remaining != sys_le16_to_cpu(hdr->len)) {
        LOG_ERR("ACL payload length is not correct");
        net_buf_unref(buf);
        return NULL;
    }

    if (remaining > net_buf_tailroom(buf)) {
        LOG_ERR("Not enough space in buffer");
        net_buf_unref(buf);
        return NULL;
    }

    LOG_DBG("len %u", remaining);
    net_buf_add_mem(buf, data, remaining);

    return buf;
}

static struct net_buf *hci_ipc_iso_recv(uint8_t *data, size_t remaining) {
    struct bt_hci_iso_hdr *hdr = (void *)data;
    struct net_buf *buf;

    if (remaining < sizeof(*hdr)) {
        LOG_ERR("Not enough data for ISO header");
        return NULL;
    }

    buf = bt_buf_get_tx(BT_BUF_ISO_OUT, K_NO_WAIT, hdr, sizeof(*hdr));
    if (buf) {
        data += sizeof(*hdr);
        remaining -= sizeof(*hdr);
    } else {
        LOG_ERR("No available ISO buffers!");
        return NULL;
    }

    if (remaining != bt_iso_hdr_len(sys_le16_to_cpu(hdr->len))) {
        LOG_ERR("ISO payload length is not correct");
        net_buf_unref(buf);
        return NULL;
    }

    if (remaining > net_buf_tailroom(buf)) {
        LOG_ERR("Not enough space in buffer");
        net_buf_unref(buf);
        return NULL;
    }

    LOG_DBG("len %zu", remaining);
    net_buf_add_mem(buf, data, remaining);

    return buf;
}

static void hci_ipc_recv(uint8_t *data, size_t len) {
    uint8_t pkt_indicator;
    struct net_buf *buf = NULL;
    size_t remaining = len;

    LOG_HEXDUMP_DBG(data, len, "IPC data:");

    pkt_indicator = *data++;
    remaining -= sizeof(pkt_indicator);

    switch (pkt_indicator) {
        case HCI_IPC_CMD:
            buf = hci_ipc_cmd_recv(data, remaining);
            break;

        case HCI_IPC_ACL:
            buf = hci_ipc_acl_recv(data, remaining);
            break;

        case HCI_IPC_ISO:
            buf = hci_ipc_iso_recv(data, remaining);
            break;

        default:
            LOG_ERR("Unknown HCI type %u", pkt_indicator);
            return;
    }

    if (buf) {
        net_buf_put(&tx_queue, buf);

        LOG_HEXDUMP_DBG(buf->data, buf->len, "Final net buffer:");
    }
}

static void hci_ipc_send(struct net_buf *buf, bool is_fatal_err) {
    uint8_t pkt_indicator;
    uint8_t retries = 0;
    int ret;

    LOG_DBG("buf %p type %u len %u", buf, bt_buf_get_type(buf), buf->len);

    LOG_HEXDUMP_DBG(buf->data, buf->len, "Controller buffer:");

    switch (bt_buf_get_type(buf)) {
        case BT_BUF_ACL_IN:
            pkt_indicator = HCI_IPC_ACL;
            break;
        case BT_BUF_EVT:
            pkt_indicator = HCI_IPC_EVT;
            break;
        case BT_BUF_ISO_IN:
            pkt_indicator = HCI_IPC_ISO;
            break;
        default:
            LOG_ERR("Unknown type %u", bt_buf_get_type(buf));
            net_buf_unref(buf);
            return;
    }
    net_buf_push_u8(buf, pkt_indicator);

    LOG_HEXDUMP_DBG(buf->data, buf->len, "Final HCI buffer:");

    do {
        ret = ipc_service_send(&hci_ept, buf->data, buf->len);
        if (ret < 0) {
            retries++;
            if (retries > 10) {
                /* Default backend (rpmsg_virtio) has a timeout of 150ms. */
                LOG_WRN("IPC send has been blocked for 1.5 seconds.");
                retries = 0;
            }

            /* The function can be called by the application main thread,
             * bt_ctlr_assert_handle and k_sys_fatal_error_handler. In case of a
             * call by Bluetooth Controller assert handler or system fatal error
             * handler the call can be from ISR context, hence there is no
             * thread to yield. Besides that both handlers implement a policy to
             * provide error information and stop the system in an infinite
             * loop. The goal is to prevent any other damage to the system if
             * one of such exeptional situations occur, hence call to k_yield is
             * against it.
             */
            if (is_fatal_err) {
                LOG_ERR("IPC service send error: %d", ret);
            } else {
                k_yield();
            }
        }
    } while (ret < 0);

    LOG_DBG("Sent message of %d bytes.", ret);

    net_buf_unref(buf);
}

static void rx_thread(void *p1, void *p2, void *p3) {
    k_sem_take(&ipc_bound_sem, K_FOREVER);

    while (1) {
        struct net_buf *buf;

        buf = net_buf_get(&rx_queue, K_FOREVER);
        hci_ipc_send(buf, HCI_REGULAR_MSG);

        /* Give other threads a chance to run if rx_queue keeps getting
         * new data all the time.
         */
        k_yield();
    }
}

static void tx_thread(void *p1, void *p2, void *p3) {
    while (1) {
        struct net_buf *buf;
        int err;

        /* Wait until a buffer is available */
        buf = net_buf_get(&tx_queue, K_FOREVER);
        /* Pass buffer to the stack */
        err = bt_send(buf);
        if (err) {
            LOG_ERR("Unable to send (err %d)", err);
            net_buf_unref(buf);
        }

        /* Give other threads a chance to run if tx_queue keeps getting
         * new data all the time.
         */
        k_yield();
    }
}

#if defined(CONFIG_BT_CTLR_ASSERT_HANDLER)
void bt_ctlr_assert_handle(char *file, uint32_t line) {
    /* Disable interrupts, this is unrecoverable */
    (void)irq_lock();

#if defined(CONFIG_BT_HCI_VS_FATAL_ERROR)
    /* Generate an error event only when IPC service endpoint is already bound.
     */
    if (ipc_ept_ready) {
        /* Prepare vendor specific HCI debug event */
        struct net_buf *buf;

        buf = hci_vs_err_assert(file, line);
        if (buf == NULL) {
            /* Send the event over ipc */
            hci_ipc_send(buf, HCI_FATAL_ERR_MSG);
        } else {
            LOG_ERR("Can't create Fatal Error HCI event: %s at %d", __FILE__,
                    __LINE__);
        }
    } else {
        LOG_ERR("IPC endpoint is not ready yet: %s at %d", __FILE__, __LINE__);
    }

    LOG_ERR("Halting system");

#else /* !CONFIG_BT_HCI_VS_FATAL_ERROR */
    LOG_ERR("Controller assert in: %s at %d", file, line);

#endif /* !CONFIG_BT_HCI_VS_FATAL_ERROR */

    /* Flush the logs before locking the CPU */
    LOG_PANIC();

    while (true) {
    };
}
#endif /* CONFIG_BT_CTLR_ASSERT_HANDLER */

#if defined(CONFIG_BT_HCI_VS_FATAL_ERROR)
void k_sys_fatal_error_handler(unsigned int reason, const z_arch_esf_t *esf) {
    /* Disable interrupts, this is unrecoverable */
    (void)irq_lock();

    /* Generate an error event only when there is a stack frame and IPC service
     * endpoint is already bound.
     */
    if (esf != NULL && ipc_ept_ready) {
        /* Prepare vendor specific HCI debug event */
        struct net_buf *buf;

        buf = hci_vs_err_stack_frame(reason, esf);
        if (buf != NULL) {
            hci_ipc_send(buf, HCI_FATAL_ERR_MSG);
        } else {
            LOG_ERR("Can't create Fatal Error HCI event.\n");
        }
    }

    LOG_ERR("Halting system");

    /* Flush the logs before locking the CPU */
    LOG_PANIC();

    while (true) {
    };

    CODE_UNREACHABLE;
}
#endif /* CONFIG_BT_HCI_VS_FATAL_ERROR */

static void hci_ept_bound(void *priv) {
    k_sem_give(&ipc_bound_sem);
#if defined(CONFIG_BT_CTLR_ASSERT_HANDLER) || \
    defined(CONFIG_BT_HCI_VS_FATAL_ERROR)
    ipc_ept_ready = true;
#endif /* CONFIG_BT_CTLR_ASSERT_HANDLER || CONFIG_BT_HCI_VS_FATAL_ERROR */
}

static void hci_ept_recv(const void *data, size_t len, void *priv) {
    LOG_DBG("Received message of %u bytes.", len);
    hci_ipc_recv((uint8_t *)data, len);
}

static struct ipc_ept_cfg hci_ept_cfg = {
    .name = "nrf_bt_hci",
    .cb =
        {
            .bound = hci_ept_bound,
            .received = hci_ept_recv,
        },
};

int hci_ipc_init(void) {
    int err;
    const struct device *hci_ipc_instance =
        DEVICE_DT_GET(DT_CHOSEN(zephyr_bt_hci_ipc));

    LOG_DBG("Start");

    /* Enable the raw interface, this will in turn open the HCI driver */
    err = bt_enable_raw(&rx_queue);
    if (err < 0) {
        LOG_ERR("Bluetooth initialization failed: %d\n", err);
    }

    /* Initialize IPC service instance and register endpoint. */
    err = ipc_service_open_instance(hci_ipc_instance);
    if (err < 0 && err != -EALREADY) {
        LOG_ERR("IPC service instance initialization failed: %d\n", err);
        return err;
    }

    err =
        ipc_service_register_endpoint(hci_ipc_instance, &hci_ept, &hci_ept_cfg);
    if (err) {
        LOG_ERR("Registering endpoint failed with %d", err);
        return err;
    }

    /* Spawn the RX thread and start receiving commands and data from the
     * controller.
     */
    k_thread_create(&rx_thread_data, rx_thread_stack,
                    K_THREAD_STACK_SIZEOF(rx_thread_stack), rx_thread, NULL,
                    NULL, NULL, K_PRIO_COOP(7), 0, K_NO_WAIT);
    k_thread_name_set(&tx_thread_data, "HCI ipc RX");

    /* Spawn the TX thread and start feeding commands and data to the
     * controller
     */
    k_thread_create(&tx_thread_data, tx_thread_stack,
                    K_THREAD_STACK_SIZEOF(tx_thread_stack), tx_thread, NULL,
                    NULL, NULL, K_PRIO_COOP(7), 0, K_NO_WAIT);
    k_thread_name_set(&tx_thread_data, "HCI ipc TX");

    return 0;
}
```

## src/hci_ipc.h
```c
int hci_ipc_init(void);
```
